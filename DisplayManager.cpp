#include "DisplayManager.h"
#include "Arduino.h"
#include <ArduinoJson.h>
#include <Adafruit_GFX.h>
#include <Adafruit_SharpMem.h>
#include "esp_mac.h" 

// 'LOCK', 16x16px
const unsigned char bmp_LOCK [] PROGMEM = {
	0x00, 0x00, 0x03, 0xc0, 0x06, 0x60, 0x04, 0x20, 0x04, 0x20, 0x04, 0x20, 0x0f, 0xf0, 0x0f, 0xf0, 
	0x0f, 0x70, 0x0f, 0x70, 0x0f, 0x70, 0x0e, 0x70, 0x0f, 0xf0, 0x0f, 0xf0, 0x00, 0x00, 0x00, 0x00
};
// 'LOCK_OPEN', 16x16px
const unsigned char bmp_LOCK_OPEN [] PROGMEM = {
	0x00, 0x00, 0x00, 0x3c, 0x00, 0x66, 0x00, 0x42, 0x00, 0x42, 0x00, 0x42, 0x1f, 0xe0, 0x1f, 0xe0, 
	0x1e, 0xe0, 0x1e, 0xe0, 0x1e, 0xe0, 0x1c, 0xe0, 0x1f, 0xe0, 0x1f, 0xe0, 0x00, 0x00, 0x00, 0x00
};
// 'PROCESSING', 16x16px
const unsigned char bmp_PROCESSING [] PROGMEM = {
	0x00, 0x00, 0x03, 0xc0, 0x03, 0xc0, 0x13, 0xc8, 0x3f, 0xfc, 0x7f, 0xfe, 0x3e, 0x7c, 0x1c, 0x38, 
	0x1c, 0x38, 0x3e, 0x7c, 0x7f, 0xfe, 0x3f, 0xfc, 0x13, 0xc8, 0x03, 0xc0, 0x03, 0xc0, 0x00, 0x00
};
// 'WIFI', 16x16px
const unsigned char bmp_WIFI [] PROGMEM = {
	0x00, 0x00, 0x00, 0x00, 0x03, 0xc0, 0x1f, 0xf8, 0x30, 0x0c, 0x60, 0x06, 0x40, 0x02, 0x07, 0xe0, 
	0x0f, 0xf0, 0x08, 0x10, 0x00, 0x00, 0x01, 0x80, 0x01, 0x80, 0x00, 0x00, 0x00, 0x00, 0x00, 0x00
};
// 'RECORD', 16x16px
const unsigned char bmp_RECORD [] PROGMEM = {
	0x00, 0x00, 0x03, 0xc0, 0x03, 0xc0, 0x03, 0xc0, 0x03, 0xc0, 0x03, 0xc0, 0x13, 0xc8, 0x13, 0xc8, 
	0x1b, 0xd8, 0x08, 0x10, 0x0e, 0x70, 0x03, 0xc0, 0x01, 0x80, 0x01, 0x80, 0x03, 0xc0, 0x00, 0x00
};
// 'WIFI-FAIL', 16x16px
const unsigned char bmp_WIFI_FAIL [] PROGMEM = {
	0x00, 0x00, 0x00, 0x04, 0x03, 0xc8, 0x1f, 0x90, 0x30, 0x24, 0x60, 0x46, 0x40, 0x82, 0x01, 0x20, 
	0x02, 0x70, 0x04, 0x10, 0x08, 0x00, 0x11, 0x80, 0x21, 0x80, 0x00, 0x00, 0x00, 0x00, 0x00, 0x00
};
// 'WIFI-OFF', 16x16px
const unsigned char bmp_WIFI_OFF [] PROGMEM = {
	0x00, 0x00, 0x00, 0x00, 0x03, 0xc0, 0x0c, 0x30, 0x00, 0x00, 0x00, 0x00, 0x00, 0x00, 0x03, 0xc0, 
	0x00, 0x00, 0x00, 0x00, 0x00, 0x00, 0x01, 0x80, 0x01, 0x80, 0x00, 0x00, 0x00, 0x00, 0x00, 0x00
};
// 'POWER', 16x16px
const unsigned char bmp_POWER [] PROGMEM = {
	0x00, 0x00, 0x00, 0x10, 0x00, 0x30, 0x00, 0x60, 0x00, 0xe0, 0x01, 0xc0, 0x03, 0x80, 0x0f, 0x80, 
	0x1f, 0xf8, 0x01, 0xf0, 0x01, 0xe0, 0x03, 0x80, 0x07, 0x00, 0x06, 0x00, 0x0c, 0x00, 0x00, 0x00
};
// 'BATTERY', 16x16px
const unsigned char bmp_BATTERY [] PROGMEM = {
	0x00, 0x00, 0x00, 0x00, 0x00, 0x00, 0x00, 0x00, 0x3f, 0xf8, 0x40, 0x04, 0x40, 0x04, 0x40, 0x06, 
	0x40, 0x06, 0x40, 0x04, 0x40, 0x04, 0x3f, 0xf8, 0x00, 0x00, 0x00, 0x00, 0x00, 0x00, 0x00, 0x00
};
// 'HEART', 16x16px
const unsigned char bmp_HEART [] PROGMEM = {
	0x00, 0x00, 0x00, 0x00, 0x0c, 0x30, 0x1e, 0x78, 0x3f, 0xfc, 0x3f, 0xfc, 0x3f, 0xfc, 0x3f, 0xfc, 
	0x3f, 0xfc, 0x1f, 0xf8, 0x0f, 0xf0, 0x07, 0xe0, 0x03, 0xc0, 0x01, 0x80, 0x00, 0x00, 0x00, 0x00
};
// 'SUN', 16x16px
const unsigned char bmp_SUN [] PROGMEM = {
	0x01, 0x80, 0x01, 0x80, 0x33, 0xcc, 0x3f, 0xfc, 0x1c, 0x38, 0x19, 0x98, 0x33, 0xcc, 0xf7, 0xef, 
	0xf7, 0xef, 0x33, 0xcc, 0x19, 0x98, 0x1c, 0x38, 0x3f, 0xfc, 0x33, 0xcc, 0x01, 0x80, 0x01, 0x80
};
// 'MOON', 16x16px
const unsigned char bmp_MOON [] PROGMEM = {
	0x00, 0x00, 0x00, 0x00, 0x03, 0xc0, 0x0f, 0x00, 0x1e, 0x00, 0x1e, 0x00, 0x3e, 0x00, 0x3e, 0x00, 
	0x3e, 0x00, 0x3e, 0x00, 0x1f, 0x00, 0x1f, 0x80, 0x0f, 0xf0, 0x03, 0xc0, 0x00, 0x00, 0x00, 0x00
};
// 'NEWS', 16x16px
const unsigned char bmp_NEWS [] PROGMEM = {
	0x00, 0x00, 0x01, 0x00, 0x01, 0x80, 0x03, 0xc0, 0x03, 0xc0, 0x03, 0xc0, 0x1f, 0xf8, 0x3f, 0xfe, 
	0x7f, 0xfc, 0x1f, 0xf8, 0x03, 0xc0, 0x03, 0xc0, 0x03, 0xc0, 0x01, 0x80, 0x00, 0x80, 0x00, 0x00
};
// 'WAITING', 16x16px
const unsigned char bmp_WAITING [] PROGMEM = {
	0x00, 0x00, 0x1f, 0xf8, 0x08, 0x10, 0x08, 0x10, 0x08, 0x10, 0x07, 0xe0, 0x03, 0xc0, 0x01, 0x80, 
	0x01, 0x80, 0x02, 0x40, 0x04, 0x20, 0x08, 0x10, 0x0f, 0xf0, 0x0f, 0xf0, 0x1f, 0xf8, 0x00, 0x00
};
// 'BLE', 16x16px
const unsigned char bmp_BLE [] PROGMEM = {
	0x01, 0x00, 0x01, 0x80, 0x01, 0xc0, 0x19, 0x60, 0x0d, 0x30, 0x07, 0x30, 0x03, 0x60, 0x01, 0xc0, 
	0x01, 0xc0, 0x03, 0x60, 0x07, 0x30, 0x0d, 0x30, 0x19, 0x60, 0x01, 0xc0, 0x01, 0x80, 0x01, 0x00
};
// 'BLE_OFF', 16x16px
const unsigned char bmp_BLE_OFF [] PROGMEM = {
	0x01, 0x00, 0x01, 0x80, 0x01, 0xc4, 0x19, 0x48, 0x0d, 0x10, 0x07, 0x20, 0x02, 0x40, 0x00, 0x80, 
	0x01, 0x00, 0x02, 0x60, 0x04, 0x30, 0x09, 0x30, 0x11, 0x60, 0x21, 0xc0, 0x01, 0x80, 0x01, 0x00
};

// 'RECORD_L', 80x80px
const unsigned char bmp_RECORD_L [] PROGMEM = {
	0x00, 0x00, 0x00, 0x00, 0x00, 0x00, 0x00, 0x00, 0x00, 0x00, 0x00, 0x00, 0x00, 0x00, 0x00, 0x00, 
	0x00, 0x00, 0x00, 0x00, 0x00, 0x00, 0x00, 0x00, 0x07, 0xe0, 0x00, 0x00, 0x00, 0x00, 0x00, 0x00, 
	0x00, 0x00, 0x3f, 0xfc, 0x00, 0x00, 0x00, 0x00, 0x00, 0x00, 0x00, 0x00, 0xff, 0xff, 0x00, 0x00, 
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	0x00, 0x00, 0x00, 0x00, 0x00, 0x00, 0x00, 0x00, 0x00, 0x00, 0x00, 0x00, 0x00, 0x00, 0x00, 0x00
};
// 'SAVE_L', 80x80px
const unsigned char bmp_SAVE_L [] PROGMEM = {
	0x00, 0x00, 0x00, 0x00, 0x00, 0x00, 0x00, 0x00, 0x00, 0x00, 0x00, 0x00, 0x00, 0x00, 0x00, 0x00, 
	0x00, 0x00, 0x00, 0x00, 0x00, 0x3f, 0xff, 0xff, 0xff, 0xff, 0xff, 0x80, 0x00, 0x00, 0x01, 0xff, 
	0xff, 0xff, 0xff, 0xff, 0xff, 0xe0, 0x00, 0x00, 0x03, 0xff, 0xff, 0xff, 0xff, 0xff, 0xff, 0xf8, 
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	0x00, 0x00, 0x00, 0x00, 0x00, 0x00, 0x00, 0x00, 0x00, 0x00, 0x00, 0x00, 0x00, 0x00, 0x00, 0x00
};
// 'USB_L', 80x80px
const unsigned char bmp_USB_L [] PROGMEM = {
	0x00, 0x00, 0x00, 0x00, 0x00, 0x00, 0x00, 0x00, 0x00, 0x00, 0x00, 0x00, 0x00, 0x00, 0x00, 0x00, 
	0x00, 0x00, 0x00, 0x00, 0x00, 0x00, 0x00, 0x00, 0x01, 0x80, 0x00, 0x00, 0x00, 0x00, 0x00, 0x00, 
	0x00, 0x00, 0x01, 0x80, 0x00, 0x00, 0x00, 0x00, 0x00, 0x00, 0x00, 0x00, 0x03, 0xc0, 0x00, 0x00, 
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	0x0f, 0xf0, 0x00, 0x00, 0x00, 0x00, 0x00, 0x00, 0x00, 0x00, 0x00, 0x00, 0x00, 0x00, 0x00, 0x00
};

RTC_DATA_ATTR int16_t fullscreenNoteNumber = -1;

void DisplayManager::init(NotesManager *notesManager) {
  nm = notesManager;
  display.begin();
  display.cp437(true);
  display.setRotation(1);
  display.setTextSize(2);
  display.setTextColor(BLACK);

  noteField.setTextSize(2);
  noteField.cp437(true);
  screenElement.cp437(true);
  offScreen.cp437(true);
  screenElement.setRotation(1);
  screenElement.setTextColor(BLACK);

  offScreen.setRotation(1);
}

void DisplayManager::refresh() {
  display.refresh();
}

void DisplayManager::drawBaseLayout() {
  ESP_LOGV(TAG, "Drawing base layout.");
  display.fillRect(0, 0, SCREEN_WIDTH, SCREEN_HEIGHT, WHITE);
  //display.drawFastHLine(0, HEADER_HEIGHT - 2, SCREEN_WIDTH, BLACK);
  display.drawFastHLine(0, HEADER_HEIGHT, SCREEN_WIDTH, BLACK);
  display.drawFastHLine(0, HEADER_HEIGHT + NOTE_HEIGHT, SCREEN_WIDTH, BLACK);
  display.drawFastHLine(0, HEADER_HEIGHT + NOTE_HEIGHT * 2, SCREEN_WIDTH, BLACK);
  display.drawFastHLine(0, HEADER_HEIGHT + NOTE_HEIGHT * 3, SCREEN_WIDTH, BLACK);
  display.drawFastHLine(0, HEADER_HEIGHT + NOTE_HEIGHT * 4, SCREEN_WIDTH, BLACK);
  display.drawFastHLine(0, HEADER_HEIGHT + NOTE_HEIGHT * 5, SCREEN_WIDTH, BLACK);
  display.fillRect(0, 0, SCREEN_WIDTH, HEADER_HEIGHT, BLACK);
  display.fillRoundRect(0, HEADER_HEIGHT - 2, SCREEN_WIDTH, 8, 4, WHITE);
  display.drawFastVLine(20, HEADER_HEIGHT - 4, SCREEN_HEIGHT - HEADER_HEIGHT, BLACK);
  drawHeader(); 
}

void DisplayManager::drawHeader() {
  display.fillRoundRect(0, 0, SCREEN_WIDTH, HEADER_HEIGHT - 8 + 2, 4, WHITE);
  
  uint8_t leftIndex = 0; 
  
  if (systemConfig.showClock){
    display.setTextSize(2);
    display.setCursor(HEADER_MARGIN + leftIndex * HEADER_ICON_SPACING, HEADER_MARGIN);
    time_t now = time(NULL);         // Get current time
    struct tm *t = localtime(&now);  // Convert to local time structure
    display.printf("%02d", t->tm_hour);
    display.print(":");
    display.printf("%02d", t->tm_min);
    leftIndex += 3;
  }

  if (systemConfig.showCompletionRate){
    // TODO: Move to the right.
    display.setTextSize(1);
    display.setCursor(HEADER_MARGIN + leftIndex * HEADER_ICON_SPACING, HEADER_MARGIN);
    display.write(0xF0);
    display.printf("%d", nm->getNoteCount());
    display.setCursor(HEADER_MARGIN + leftIndex * HEADER_ICON_SPACING, HEADER_MARGIN + 8);
    display.write(0x2F);
    display.printf("%d", nm->getNoteCheckedCount());
    leftIndex ++;
  }

  if (status.filesWaiting != 0 || status.responsesWaiting != 0){
    drawHeaderIcon(bmp_WAITING, ALIGN_LEFT, leftIndex);
    leftIndex ++;
    uint8_t totalWaiting = status.filesWaiting + status.responsesWaiting;
    if (totalWaiting > 1){
      display.setTextSize(2);
      display.setCursor(HEADER_MARGIN + leftIndex * HEADER_ICON_SPACING - 6, HEADER_MARGIN);
      display.printf("%d", totalWaiting);
      leftIndex ++;
    }
  }

  if (status.hasNews){
    drawHeaderIcon(bmp_NEWS, ALIGN_LEFT, leftIndex);
    leftIndex ++;
  }

  if (status.processes != 0){
    drawHeaderIcon(bmp_PROCESSING, ALIGN_LEFT, leftIndex);
    leftIndex ++;
  }
  if (status.recording){
    drawHeaderIcon(bmp_RECORD, ALIGN_LEFT, leftIndex);
    leftIndex ++;
  }
  
  if (status.sleeping){
    drawHeaderIcon(bmp_MOON, ALIGN_MID, 0);
  }else{
    drawHeaderIcon(bmp_SUN, ALIGN_MID, 0);
  }

  uint8_t rightIndex = 0;

  if (status.locked){
    drawHeaderIcon(bmp_LOCK, ALIGN_RIGHT, rightIndex);
  }else {
    drawHeaderIcon(bmp_LOCK_OPEN, ALIGN_RIGHT, rightIndex);
  }
  rightIndex ++;
  
  if (status.charging){
    drawHeaderIcon(bmp_POWER, ALIGN_RIGHT, rightIndex);
  }else {
    drawHeaderIcon(bmp_BATTERY, ALIGN_RIGHT, rightIndex);
    display.fillRect(SCREEN_WIDTH - HEADER_MARGIN - HEADER_ICON_SIZE - rightIndex * HEADER_ICON_SPACING + 3, 4+6, map(status.battery, 0, 100, 0, 9), 4, BLACK);
  }
  rightIndex ++;

  if (systemConfig.hasWifi){
    if (status.wifi){
    drawHeaderIcon(bmp_WIFI, ALIGN_RIGHT, rightIndex);
    }else {
      drawHeaderIcon(bmp_WIFI_FAIL, ALIGN_RIGHT, rightIndex);
    }
    rightIndex ++;
  }

  if (systemConfig.hasBLE){
    if (status.ble){
      drawHeaderIcon(bmp_BLE, ALIGN_RIGHT, rightIndex);
    }else {
      drawHeaderIcon(bmp_BLE_OFF, ALIGN_RIGHT, rightIndex);
    }
    rightIndex ++;
  }
  

  if (systemConfig.showMAC){
    //Draw last few bytes of MAC - for identification
    display.setTextSize(1);
    unsigned char mac_base[8] = {0};
    esp_efuse_mac_get_default(mac_base); // TODO: Extract to not read off repeatedly
    display.setCursor(SCREEN_WIDTH -  HEADER_MARGIN - HEADER_ICON_SIZE - rightIndex * HEADER_ICON_SPACING, HEADER_MARGIN);
    display.printf("%02X", mac_base[4]);
    display.setCursor(SCREEN_WIDTH - HEADER_MARGIN - HEADER_ICON_SIZE - rightIndex * HEADER_ICON_SPACING, HEADER_MARGIN + 8);
    display.printf("%02X", mac_base[5]);
  }

  
  display.setTextSize(3);
  int16_t refX;
  int16_t refY;
  uint16_t textWidth;
  uint16_t textHeight;
  String notebookName = nm->getNotebookNameCP437();
  display.getTextBounds(notebookName, 0, 0, &refX, &refY, &textWidth, &textHeight);
  display.setCursor((SCREEN_WIDTH - textWidth)/2, 28);
  display.print(notebookName);
  display.fillTriangle(4, 40, 12, 40+4, 12, 40-4, BLACK);
  display.fillTriangle(SCREEN_WIDTH-4, 40, SCREEN_WIDTH-12, 40+4, SCREEN_WIDTH-12, 40-4, BLACK);
}

void DisplayManager::drawHeaderIcon(const unsigned char * icon, horizontal_alignment_t alignment, uint8_t index){
  if (alignment == ALIGN_LEFT){
    display.drawBitmap(HEADER_MARGIN + index * HEADER_ICON_SPACING, HEADER_MARGIN, icon, HEADER_ICON_SIZE, HEADER_ICON_SIZE, BLACK);
  }else if (alignment == ALIGN_RIGHT){
    display.drawBitmap(SCREEN_WIDTH - HEADER_MARGIN - HEADER_ICON_SIZE - index * HEADER_ICON_SPACING, HEADER_MARGIN, icon, HEADER_ICON_SIZE, HEADER_ICON_SIZE, BLACK);
  }
  else{
    display.drawBitmap(SCREEN_WIDTH/2 - HEADER_ICON_SIZE/2, HEADER_MARGIN, icon, HEADER_ICON_SIZE, HEADER_ICON_SIZE, BLACK);
  }
}

void DisplayManager::revealDisplay() {
  ESP_LOGD(TAG, "Revealing display.");
  drawBaseLayout();
  display.refresh();

  for (int i = nm->getNoteIndex(); i < min((int16_t)(nm->getNoteIndex() + 6), nm->getNoteCount()); i++) {
    slideInNote(i);
    drawNoteWidget(i);
    display.refresh();
  }
}

void DisplayManager::redrawDisplay(bool shouldRefresh) {
  ESP_LOGV(TAG, "Redrawing entire display.");
  drawBaseLayout();
  for (int i = nm->getNoteIndex(); i < nm->getNoteIndex() + 6; i++) {
    prepareNoteField(i);
    display.drawBitmap(SCREEN_WIDTH - noteField.width(), HEADER_HEIGHT + 1 + (i - nm->getNoteIndex()) * NOTE_HEIGHT, noteField.getBuffer(), noteField.width(), noteField.height(), BLACK, WHITE);
    drawNoteWidget(i);
  }
  if (shouldRefresh){
    if (isFullscreenNote()){
      drawFullscreenNote();
    }
    display.refresh();
  }
}

void DisplayManager::drawNoteWidget(int16_t noteNumber, int16_t screenPosition) {
  ESP_LOGV(TAG, "Drawing widget for note %d.", noteNumber);
  int16_t screenIndex;
  if (screenPosition == -1){
     screenIndex = noteNumber - nm->getNoteIndex();
  }else{
    screenIndex = noteNumber - screenPosition;
  }
  if (screenIndex<0 || screenIndex>5){return;} // Don't draw widgets that don't exist
  display.fillRect(0, HEADER_HEIGHT + 1 + screenIndex * NOTE_HEIGHT, 20, NOTE_HEIGHT - 2, WHITE);
  int16_t midPosX = 10;
  int16_t midPosY = HEADER_HEIGHT + 1 + screenIndex * NOTE_HEIGHT + NOTE_HEIGHT / 2;
  if(screenIndex == 0 && noteNumber != 0){
    // Notes above, can scroll up, arrow up
    display.fillTriangle(midPosX-4, midPosY+4, midPosX+4, midPosY+4, midPosX, midPosY-4, BLACK);
  }else if(screenIndex == 5 && noteNumber<(nm->getNoteCount()-1)){
    // Notes below, can scroll down, arrow down
    display.fillTriangle(midPosX-4, midPosY-4, midPosX+4, midPosY-4, midPosX, midPosY+4, BLACK);
  }
  else if (noteNumber < nm->getNoteCount()) {
    if (nm->getNoteChecked(noteNumber)) {
      display.fillCircle(midPosX, midPosY, 5, 0);
    } else {
      display.drawCircle(midPosX, midPosY, 5, 0);
    }
  }
}

void DisplayManager::slideInNote(int16_t noteNo) {
  if (!indexIsOnScreen(noteNo)) {
    ESP_LOGD(TAG, "Tried to slide in note outside screen.");
    return;  // Outside screen, no reason to animate
  }

  ESP_LOGD(TAG, "Sliding in note %d.", noteNo);
  unsigned long startTime = millis();
  unsigned long endTime = startTime + SLIDE_TIME;
  prepareNoteField(noteNo);
  while (millis() < endTime) {
    unsigned long deltaTime = millis() - startTime;
    float animProgress = ((float)deltaTime) / ((float)SLIDE_TIME);
    float animProgressEased = easeOut(animProgress);
    unsigned int notePosOffset = (unsigned int)ceil(animProgressEased * (float)noteField.width());
    display.drawBitmap(SCREEN_WIDTH - notePosOffset, HEADER_HEIGHT + 1 + (noteNo - nm->getNoteIndex()) * NOTE_HEIGHT, noteField.getBuffer(), noteField.width(), noteField.height(), BLACK, WHITE);
    display.refresh();
  }
  display.drawBitmap(SCREEN_WIDTH - noteField.width(), HEADER_HEIGHT + 1 + (noteNo - nm->getNoteIndex()) * NOTE_HEIGHT, noteField.getBuffer(), noteField.width(), noteField.height(), BLACK, WHITE);
  display.refresh();
}

void DisplayManager::slideOutNote(int16_t noteNo) {
  if (!indexIsOnScreen(noteNo)) {
    ESP_LOGD(TAG, "Tried to slide out note outside screen.");
    return;  // Outside screen, no reason to animate
  }

  ESP_LOGD(TAG, "Sliding out note %d.", noteNo);
  unsigned long startTime = millis();
  unsigned long endTime = startTime + SLIDE_TIME;
  prepareNoteField(noteNo);
  while (millis() < endTime) {
    unsigned long deltaTime = millis() - startTime;
    float animProgress = ((float)deltaTime) / ((float)SLIDE_TIME);
    float animProgressEased = easeIn(animProgress);
    unsigned int notePosOffset = (unsigned int)ceil(animProgressEased * (float)noteField.width());
    display.fillRect(SCREEN_WIDTH - noteField.width(), HEADER_HEIGHT + 1 + (noteNo - nm->getNoteIndex()) * NOTE_HEIGHT, noteField.width() - notePosOffset, noteField.height(), WHITE);
    display.drawBitmap(SCREEN_WIDTH - noteField.width() + notePosOffset, HEADER_HEIGHT + 1 + (noteNo - nm->getNoteIndex()) * NOTE_HEIGHT, noteField.getBuffer(), noteField.width(), noteField.height(), BLACK, WHITE);
    display.refresh();
  }
  display.fillRect(SCREEN_WIDTH - noteField.width(), HEADER_HEIGHT + 1 + (noteNo - nm->getNoteIndex()) * NOTE_HEIGHT, noteField.width(), noteField.height(), WHITE);
  display.refresh();
}

void DisplayManager::slideOutInNotebook(bool rightwards){
  if(rightwards){
    ESP_LOGD(TAG, "Sliding out note rightwards.");
  }else{
    ESP_LOGD(TAG, "Sliding out note leftwards.");
  }
  
  unsigned long startTime = millis();
  unsigned long endTime = startTime + SCREEN_SWITCH_TIME;
  while (millis() < endTime) {
    unsigned long deltaTime = millis() - startTime;
    float animProgress = ((float)deltaTime) / ((float)SCREEN_SWITCH_TIME);
    float animProgressEased = easeIn(animProgress);
    unsigned int slideWidth = (unsigned int)ceil(animProgressEased * SCREEN_WIDTH);
    if(rightwards){
      display.fillRect(0, HEADER_HEIGHT, slideWidth, SCREEN_HEIGHT - HEADER_HEIGHT, WHITE);
    }else{
      display.fillRect(SCREEN_WIDTH - slideWidth, HEADER_HEIGHT, slideWidth, SCREEN_HEIGHT - HEADER_HEIGHT, WHITE);
    }
    display.refresh();
  }

  // Save target layout to buffer
  redrawDisplay(false);
  memmove(
          offScreen.getBuffer(),  // Destination
          display.getBuffer(),       //Source
          (SCREEN_HEIGHT * SCREEN_WIDTH) / 8 );//Length

  startTime = millis();
  endTime = startTime + SCREEN_SWITCH_TIME;
  while (millis() < endTime) {
    unsigned long deltaTime = millis() - startTime;
    float animProgress = ((float)deltaTime) / ((float)SCREEN_SWITCH_TIME);
    float animProgressEased = easeOut(animProgress);
    unsigned int slideWidth = (unsigned int)ceil((1-animProgressEased) * SCREEN_WIDTH);
    /*for (int i = nm->getNoteIndex(); i < nm->getNoteIndex() + 6; i++) {
      prepareNoteField(i);
      display.drawBitmap(SCREEN_WIDTH - noteField.width(), HEADER_HEIGHT + 1 + (i - nm->getNoteIndex()) * NOTE_HEIGHT, noteField.getBuffer(), noteField.width(), noteField.height(), BLACK, WHITE);
      drawNoteWidget(i);
    }*/
    //redrawDisplay(false);
    memmove(display.getBuffer(), offScreen.getBuffer(), (SCREEN_HEIGHT * SCREEN_WIDTH) / 8 );
    if(rightwards){
      display.fillRect(SCREEN_WIDTH - slideWidth, HEADER_HEIGHT, slideWidth, SCREEN_HEIGHT - HEADER_HEIGHT, WHITE);
    }else{
      display.fillRect(0, HEADER_HEIGHT, slideWidth, SCREEN_HEIGHT - HEADER_HEIGHT, WHITE);
    }
    display.refresh();
  }
  fullscreenNoteNumber = -1; // Cancel fullscreen
  redrawDisplay();
}

bool DisplayManager::indexIsOnScreen(int16_t noteIndex) {
  int16_t screenPos =  noteIndex - nm->getNoteIndex();
  return 0 <= screenPos && screenPos <= 5;
}

void DisplayManager::openSpaceAt(int16_t noteIndex) {
  if (!indexIsOnScreen(noteIndex)) {
    ESP_LOGD(TAG, "Tried to open space outside screen.");
    return;  // Outside screen, no reason to animate
  }

  int16_t screenPos = noteIndex - nm->getNoteIndex();
  ESP_LOGD(TAG, "Opening space before note %d at screen position %d.", noteIndex, screenPos);
  prepareScreenElement(nm->getNoteIndex()+6);
  scrollToNoteIndex(nm->getNoteIndex()-1, 1, noteIndex);
}

void DisplayManager::closeSpaceAt(int16_t noteIndex) {
  if (!indexIsOnScreen(noteIndex)) {
    ESP_LOGD(TAG, "Tried to close note outside screen.");
    return;  // Outside screen, no reason to animate
  }

  int16_t screenPos = noteIndex - nm->getNoteIndex();
  ESP_LOGD(TAG, "Collapsing note %d at screen position %d.", noteIndex, screenPos);
  prepareScreenElement(nm->getNoteIndex()+6);
  scrollToNoteIndex(nm->getNoteIndex()+1, 6, noteIndex);
}

void DisplayManager::prepareNoteField(int16_t noteNumber, bool crossIfChecked) {
  // Only redraw if different from previously prepared as this is quite expensive.
  static int16_t lastNoteFieldPreparedIndex = -1;
  if (noteNumber == lastNoteFieldPreparedIndex && !crossIfChecked){
    return;
  }
  lastNoteFieldPreparedIndex = noteNumber;

  ESP_LOGV(TAG, "Preparing note field %d.", noteNumber);
  noteField.fillScreen(0);
  if (noteNumber < nm->getNoteCount() && noteNumber >= 0) {
    noteField.setCursor(0, 2);
    
    String noteText = nm->getNoteText(noteNumber);
    
    uint32_t noteTextLength = noteText.length();
    uint8_t checkLineThickness = getNoteLineThicknessFromLength(noteTextLength);
    uint8_t noteTextSize = getNoteTextSizeFromLength(noteTextLength);
    uint16_t maxTextLength = getMaxTextLengthFromSize(noteTextSize);
    if (noteTextLength > maxTextLength){
      noteText = noteText.substring(0, maxTextLength - 3);
      noteText += "...";
      noteTextLength = noteText.length();
    }
    
    noteField.setTextSize(noteTextSize); 
    noteField.print(noteText);
    
    if (crossIfChecked && nm->getNoteChecked(noteNumber)) {
      uint32_t checkLineLengthToDraw = noteTextLength * BASE_CHARACTER_WIDTH * noteTextSize;
      uint8_t checkLineIndex = 0;

      while(checkLineLengthToDraw>0){
        uint32_t checkLineLength = checkLineLengthToDraw;
        if (checkLineLength >= noteField.width()){
          checkLineLength = noteField.width();
        }
        noteField.fillRect(0, 2 + (BASE_CHARACTER_HEIGHT * noteTextSize * checkLineIndex) + (BASE_CHARACTER_HEIGHT / 2 * noteTextSize) - checkLineThickness/2, checkLineLength, checkLineThickness, WHITE);
        checkLineLengthToDraw -= checkLineLength;
        checkLineIndex += 1;
      }
    }
  }
}

uint8_t DisplayManager::getNoteTextSizeFromLength(uint32_t length){
  if (systemConfig.constTextSize){
    return systemConfig.minTextSize;
  }
  uint8_t targetSize = 1;
  if (length<6){// A single line (of max 6 characters)
    //targetSize = 6;
    targetSize = 3; // 6 too large, temp disabled
  }else if(length < 24){ // Two lines (12 characters wide)
    targetSize = 3;
  }else if(length < 54){ // Three lines (18 characters wide)
    targetSize = 2;
  }else{ // Smallest possible (36 char wide, 6 lines, 216 chars)
    targetSize = 1;
  }
  return (max( targetSize, systemConfig.minTextSize));
}

uint16_t DisplayManager::getMaxTextLengthFromSize(uint8_t textSize){
  switch(textSize){
    case 1:
      return 216;
    case 2:
      return 54;
    case 3:
    default:
      return 24;
  }
}

uint8_t DisplayManager::getFullscreenTextSizeFromLength(uint32_t length){
  if (systemConfig.constTextSize){
    return systemConfig.minTextSize;
  }
  uint8_t targetSize = 1;
  if (length<156){
    targetSize = 3;
  }else if(length < 380){
    targetSize = 2;
  }else{ // 1520 characters
    targetSize = 1;
  }
  return (max( targetSize, systemConfig.minTextSize));
}

uint8_t DisplayManager::getNoteLineThicknessFromLength(uint32_t length){
  if (systemConfig.constTextSize){
    return systemConfig.minTextSize;
  }
  uint8_t targetSize = 1;
  if (length<6){// A single line (of max 6 characters)
    //targetSize =  4;
    targetSize =  3;
  }else if(length < 24){ // Two lines (12 characters wide)
    targetSize =  3;
  }else if(length < 54){ // Three lines (18 characters wide)
    targetSize =  2;
  }else{ // Smallest possible (36 char wide, 6 lines, 216 chars)
    targetSize =  1;
  }
  return (max( targetSize, systemConfig.minTextSize)); // Breaks if min text size >4, but who would...
}

void DisplayManager::animCrossNote(int16_t noteScreenIndex, float animProgress){
  int16_t noteNumber =  nm->getNoteIndexAtScreenPosition(noteScreenIndex);
  // Clamp progress
  if (animProgress < 0.0){
    animProgress = 0.0;
  }
  if (animProgress > 1.0){
    animProgress = 1.0;
  }

  animProgress = easeIn(animProgress); // Add easing to accelerate the animation.

  // If the note is currently checked, we reverse the process
  if (nm->getNoteChecked(noteNumber)){
    animProgress = 1.0 - animProgress;
  }

  prepareNoteField(noteNumber, false); // Prepare the note without crossing it out

  // Prepare note field only if not already prepared
  static int16_t lastNoteNumber = -1;
  static uint32_t noteTextLength;
  static uint8_t noteTextSize;
  static uint8_t checkLineThickness;
  if (lastNoteNumber != noteNumber){
    noteTextLength = nm->getNoteText(noteNumber).length();
    noteTextSize = getNoteTextSizeFromLength(noteTextLength);
    checkLineThickness = getNoteLineThicknessFromLength(noteTextLength);
    lastNoteNumber = noteNumber;
    noteTextLength = min(noteTextLength, (uint32_t)getMaxTextLengthFromSize(noteTextSize));
  }

  // Copy note field to position
  display.drawBitmap(SCREEN_WIDTH - noteField.width(), HEADER_HEIGHT + 1 + noteScreenIndex * NOTE_HEIGHT, noteField.getBuffer(), noteField.width(), noteField.height(), BLACK, WHITE);
  
  // Draw partial checked line on relative note offset
  uint32_t checkLineLengthToDraw = (uint32_t)((float)(noteTextLength * BASE_CHARACTER_WIDTH * noteTextSize)* animProgress);
  uint8_t checkLineIndex = 0;

  ESP_LOGD(TAG, "Animating checking of note %d at progress %f, giving a total line length of %d", noteNumber, animProgress, checkLineLengthToDraw);

  while(checkLineLengthToDraw>0){
    uint32_t checkLineLength = checkLineLengthToDraw;
    if (checkLineLength >= noteField.width()){
      checkLineLength = noteField.width();
    }
    display.fillRect(SCREEN_WIDTH - noteField.width(), (HEADER_HEIGHT + 1 + noteScreenIndex * NOTE_HEIGHT) + 2 + (BASE_CHARACTER_HEIGHT * noteTextSize * checkLineIndex) + (BASE_CHARACTER_HEIGHT / 2 * noteTextSize) - checkLineThickness/2, checkLineLength, checkLineThickness, BLACK);
    checkLineLengthToDraw -= checkLineLength;
    checkLineIndex += 1;
  }
  display.refresh();
}

void DisplayManager::prepareScreenElement(int16_t noteNumber) {
  ESP_LOGV(TAG, "Preparing screen element %d.", noteNumber);
  screenElement.fillScreen(WHITE);
  screenElement.drawFastHLine(0, 0, 240, 0);
  screenElement.drawFastVLine(20, 0, screenElement.height(), 0);
  if (noteNumber < nm->getNoteCount() && noteNumber >= 0) {
    if (nm->getNoteChecked(noteNumber)) {
      screenElement.fillCircle(10, screenElement.height() / 2, 5, BLACK);
    } else {
      screenElement.drawCircle(10, screenElement.height() / 2, 5, BLACK);
    }
    prepareNoteField(noteNumber);
    screenElement.drawBitmap(screenElement.width() - noteField.width(), 1, noteField.getBuffer(),
                             noteField.width(), noteField.height(), BLACK, WHITE);
  }
}

int16_t DisplayManager::scrollToNoteIndex(int16_t reqIndex, int8_t allowedPastBorders, int16_t freezeIndex) {
  int16_t toIndex = reqIndex;
  if (toIndex < 0) {
    // If we're going above the list, limit to allowed distance
    if (toIndex < -allowedPastBorders) {
      toIndex = -allowedPastBorders;
    }
  } else {
    if (nm->getNoteCount() + allowedPastBorders <= 6) {
      // If screen is not full, don't move.
      ESP_LOGW(TAG, "Screen not full, no scroll");
      return nm->getNoteIndex();
    } else {
      // Never create more space than allowed past borders
      if (toIndex + 6 > nm->getNoteCount() + allowedPastBorders) {
        toIndex = nm->getNoteCount() + allowedPastBorders - 6;
      }
    }
  }
  if (toIndex != reqIndex) {
    ESP_LOGD(TAG, "Adjusted scroll index from %d to %d.", reqIndex, toIndex);
  }

  ESP_LOGD(TAG, "Scrolling to index %d, while freezing notes at index %d.", toIndex, freezeIndex);
  int deltaIndex = toIndex - nm->getNoteIndex();  // How many notes are we scrolling
  if (deltaIndex == 0) {
    return toIndex;
  }

  unsigned long startTime = millis();
  unsigned long scrollTime = SCROLL_TIME_BASE + SCROLL_TIME_BASE / 4 * abs(deltaIndex);  // Dependent on number of notes
  unsigned long endTime = startTime + scrollTime;

  int noteScrollIndexPrev = -1;  // What note is in buffer?

  unsigned int scrollDistance = abs(deltaIndex) * NOTE_HEIGHT;  // How far are we going (Should be a multiple of 8)
  unsigned int targetScrollPos = 0;                             // Ideally how many pixels offset right now
  unsigned int currentScrollPos = 0;                            // Practically how many pixels offset right now (has to be multiple of 8)
  uint16_t scrollStartHeight = HEADER_HEIGHT;

  int16_t freezeScreenIndex = freezeIndex - nm->getNoteIndex();
  if(freezeScreenIndex > 0){
    scrollStartHeight += freezeScreenIndex* NOTE_HEIGHT;
    ESP_LOGD(TAG, "Freezing at index %d gives relative index %d, scrolling starts at %d pixels", freezeIndex, freezeScreenIndex, scrollStartHeight);
  }

  while (currentScrollPos < scrollDistance) {  // In the end, what is on screen should have travelled the full scroll disatance
    // Calculate where abouts on the easing curve we are
    unsigned long deltaTime = millis() - startTime;                       // Time since we began
    float animProgressLinear = ((float)deltaTime) / ((float)scrollTime);  // Linear decimal progress
    float animProgressEased = easeInOut(animProgressLinear);              // Eased decimal progress
    targetScrollPos = (unsigned int)ceil(animProgressEased * (float)scrollDistance);
    if (animProgressEased > 1) {
      targetScrollPos = scrollDistance;  // Never let progress exceed scrollDistance
    }
    while (currentScrollPos + 8 <= targetScrollPos) {  // If we have the space to increment by 8, and move current pos along

      // Figure out what note and what segment to scroll in
      int noteScrollPos = (currentScrollPos) % NOTE_HEIGHT;  // What fraction are we scrolling in
      int noteScrollIndex;                                   // What note are we scrolling in? Depends on if at bottom or top
      if (deltaIndex > 0) {
        noteScrollIndex = nm->getNoteIndex() + 6 + (currentScrollPos) / NOTE_HEIGHT;
      } else {
        noteScrollIndex = nm->getNoteIndex() - 1 - (currentScrollPos) / NOTE_HEIGHT;
      }

      // If we're switching to a new note, load it in
      if (noteScrollIndex != noteScrollIndexPrev) {
        noteScrollIndexPrev = noteScrollIndex;
        if (freezeScreenIndex < 0 || deltaIndex > 0){
          prepareScreenElement(noteScrollIndex);
        }else{
          prepareScreenElement(nm->getNoteCount());
        }
      }

      // Setting up source and destination locations for moving buffer data around
      int displaySource, displayDestination, noteSource, noteDestination;
      if (deltaIndex > 0) {
        displaySource = 0;
        displayDestination = 1;
        noteDestination = 0;
        noteSource = (NOTE_HEIGHT - 1 - noteScrollPos) / 8;
      } else {
        displaySource = 1;
        displayDestination = 0;
        noteDestination = (SCREEN_HEIGHT - scrollStartHeight) / 8 - 1;
        noteSource = (noteScrollPos) / 8;
      }
      // Move lines, fill in bytes at the end
      for (int j = 0; j < SCREEN_WIDTH; j++) {
        // Note screen is rotated -90deg, hence header is start of screen
        // Note pixels are stored 8 in a byte, moves can only occur in offsets of 8
        // Move each line one byte upwards (or downwards
        memmove(
          display.getBuffer() + j * SCREEN_HEIGHT / 8 + displayDestination,  // Destination
          display.getBuffer() + j * SCREEN_HEIGHT / 8 + displaySource,       //Source
          SCREEN_HEIGHT / 8 - scrollStartHeight / 8 - 1);                        // Length
        // Move in line from buffer to now empty line under (or over) scrolled screen.
        display.getBuffer()[j * SCREEN_HEIGHT / 8 + noteDestination] = reverseByte(screenElement.getBuffer()[j * NOTE_HEIGHT / 8 + noteSource]);
      }
      currentScrollPos += 8;
    }
    // Current frame done refresh
    display.refresh();
  }
  for (int i = 0; i<6; i++){
    drawNoteWidget(i + toIndex, toIndex);
  }
  display.refresh();
  return toIndex;
  //refreshNotes();
}

void DisplayManager::clearToLargeIcon(uint8_t icon, bool animate) {
  if (animate){
  unsigned long startTime = millis();
  unsigned long endTime = startTime + SLIDE_TIME*2;
  while (millis() < endTime) {
    unsigned long deltaTime = millis() - startTime;
    float animProgress = ((float)deltaTime) / ((float)SLIDE_TIME*2);
    float animProgressEased = easeInOut(animProgress);
    unsigned int radius = (unsigned int)ceil(animProgressEased * (float)(234)); //Hypotenuse
    display.fillCircle(SCREEN_WIDTH/2, SCREEN_HEIGHT/2, radius, WHITE);
    if (radius>60){ //Hypotenuse, and a bit
      drawLargeIcon(icon);
    }
    display.refresh();
  }
  }
  // Clear everything for sure
  display.fillScreen(WHITE);
  drawLargeIcon(icon);
  display.refresh();
}

void DisplayManager::redrawFromLargeIcon(uint8_t icon) {
  // Draw clean display and move to buffer
  redrawDisplay(false);
  memmove(offScreen.getBuffer(), display.getBuffer(), (SCREEN_HEIGHT * SCREEN_WIDTH) / 8 );
  unsigned long startTime = millis();
  unsigned long endTime = startTime + SLIDE_TIME*2;
  while (millis() < endTime) {
    unsigned long deltaTime = millis() - startTime;
    float animProgress = ((float)deltaTime) / ((float)SLIDE_TIME*2);
    float animProgressEased = 1.0 - easeInOut(animProgress);
    unsigned int radius = (unsigned int)ceil(animProgressEased * (float)(234)); //Hypotenuse
    memmove(display.getBuffer(), offScreen.getBuffer(), (SCREEN_HEIGHT * SCREEN_WIDTH) / 8 ); // Target display
    display.fillCircle(SCREEN_WIDTH/2, SCREEN_HEIGHT/2, radius, WHITE); // Cover up
    if (radius>60){ //Hypotenuse, and a bit
      drawLargeIcon(icon);
    }
    display.refresh();
  }
  memmove(display.getBuffer(), offScreen.getBuffer(), (SCREEN_HEIGHT * SCREEN_WIDTH) / 8 );
  display.refresh();
}

void DisplayManager::drawLargeIcon(uint8_t icon){
  switch(icon){
      case ICON_USB:
        display.drawBitmap(SCREEN_WIDTH/2 - 40, SCREEN_HEIGHT/2 - 40, bmp_USB_L, 80, 80, BLACK);
      break;
      case ICON_MIC:
        display.drawBitmap(SCREEN_WIDTH/2 - 40, SCREEN_HEIGHT/2 - 40, bmp_RECORD_L, 80, 80, BLACK);
      break;
      case ICON_SAVE:
        display.drawBitmap(SCREEN_WIDTH/2 - 40, SCREEN_HEIGHT/2 - 40, bmp_SAVE_L, 80, 80, BLACK);
      break;
      default:
      break;
  }
}

void DisplayManager::delayDots() {
  static uint8_t step = 0;
  switch(step){
    case 0: 
      display.fillCircle(SCREEN_WIDTH/2-24, SCREEN_HEIGHT/2+60, 8, BLACK);
      break;
    case 1: 
      display.fillCircle(SCREEN_WIDTH/2, SCREEN_HEIGHT/2+60, 8, BLACK);
      break;
    case 2: 
      display.fillCircle(SCREEN_WIDTH/2+24, SCREEN_HEIGHT/2+60, 8, BLACK);
      break;
    case 3: 
      display.fillCircle(SCREEN_WIDTH/2-24, SCREEN_HEIGHT/2+60, 9, WHITE);
      break;
    case 4: 
      display.fillCircle(SCREEN_WIDTH/2, SCREEN_HEIGHT/2+60, 9, WHITE);
      break;
    case 5: 
      display.fillCircle(SCREEN_WIDTH/2+24, SCREEN_HEIGHT/2+60, 9, WHITE);
      break;
    default:
      break;
  }
  step ++;
  step = step % 6;
  display.refresh();
}

void DisplayManager::drawLargeTimer(uint16_t seconds){
  uint8_t minutes = seconds / 60;
  seconds = seconds % 60;
  String secondsString = String(seconds);
  String minutesString = String(minutes);
  if (secondsString.length() < 2){
    secondsString = "0"+secondsString;
  }
  if (minutesString.length() < 2){
    minutesString = "0"+minutesString;
  }

  display.fillRect(0, SCREEN_HEIGHT/2+50, SCREEN_WIDTH, 34, WHITE);
  display.setTextSize(4); //8*4 = 32 pixels heigh
  display.setCursor((SCREEN_WIDTH-5*6*4)/2, SCREEN_HEIGHT/2+51);
  display.print(minutesString);
  display.print(":");
  display.print(secondsString);

  display.refresh();
}

void DisplayManager::animFullscreenNoteIn(int16_t noteScreenIndex){
  fullscreenNoteNumber =  nm->getNoteIndexAtScreenPosition(noteScreenIndex);
  //Prep: Take screenshot, prepare lil text buffer
  prepareNoteField(fullscreenNoteNumber, false); // Prepare the note without crossing it out
  uint16_t elementsFromX = SCREEN_WIDTH - noteField.width();
  uint16_t elementsFromY = HEADER_HEIGHT + 1 + noteScreenIndex * NOTE_HEIGHT;
  uint16_t elementsFromWidth = noteField.width();
  uint16_t elementsFromHeight = noteField.height();
  uint16_t frameToX = 2;
  uint16_t frameToY = HEADER_HEIGHT + 4;
  uint16_t frameToWidth = SCREEN_WIDTH - 2 * frameToX;
  uint16_t frameToHeight = SCREEN_HEIGHT - HEADER_HEIGHT - 4 - 2;
  uint16_t innerToX = frameToX + 2;
  uint16_t innerToY = frameToY + 2;
  uint16_t innerToWidth = frameToWidth - 4;
  uint16_t innerToHeight = frameToHeight - 4;
  // Three elements - frame, inner, text
  // In progress, anim elements from innersquare, to wanted x/y width/height
  
  unsigned long startTime = millis();
  unsigned long endTime = startTime + SCREEN_SWITCH_TIME;
  while (millis() <= endTime) {
    unsigned long deltaTime = millis() - startTime;
    float animProgress = ((float)deltaTime) / ((float)SCREEN_SWITCH_TIME);
    float animProgressEased = easeInOut(animProgress);
    if (animProgressEased>1){
      animProgressEased = 1;
    }

    uint16_t frameX = animProgressEased * ((float)(frameToX - elementsFromX)) + elementsFromX;
    uint16_t frameY = animProgressEased * ((float)(frameToY - elementsFromY)) + elementsFromY;
    uint16_t frameWidth = animProgressEased * ((float)(frameToWidth - elementsFromWidth)) + elementsFromWidth;
    uint16_t frameHeight = animProgressEased * ((float)(frameToHeight - elementsFromHeight)) + elementsFromHeight;

    display.fillRect(frameX, frameY, frameWidth, frameHeight, BLACK);

    uint16_t innerX = animProgressEased * ((float)(innerToX - elementsFromX)) + elementsFromX;
    uint16_t innerY = animProgressEased * ((float)(innerToY - elementsFromY)) + elementsFromY;
    uint16_t innerWidth = animProgressEased * ((float)(innerToWidth - elementsFromWidth)) + elementsFromWidth;
    uint16_t innerHeight = animProgressEased * ((float)(innerToHeight - elementsFromHeight)) + elementsFromHeight;
    display.fillRect(innerX, innerY, innerWidth, innerHeight, WHITE);

    display.drawBitmap(innerX, innerY, noteField.getBuffer(), noteField.width(), noteField.height(), BLACK, WHITE);

    display.refresh();
  }
  drawFullscreenNote();
  display.refresh();
}

void DisplayManager::animFullscreenNoteOut(){
  if(fullscreenNoteNumber == -1){
    return;
  }
  // Save target layout to buffer
  redrawDisplay(false);
  memmove(
          offScreen.getBuffer(),  // Destination
          display.getBuffer(),       //Source
          (SCREEN_HEIGHT * SCREEN_WIDTH) / 8 );//Length
  prepareNoteField(fullscreenNoteNumber, false);

  int16_t noteScreenIndex = fullscreenNoteNumber - nm->getNoteIndex();

  uint16_t elementsFromX = SCREEN_WIDTH - noteField.width();
  uint16_t elementsFromY = HEADER_HEIGHT + 1 + noteScreenIndex * NOTE_HEIGHT;
  uint16_t elementsFromWidth = noteField.width();
  uint16_t elementsFromHeight = noteField.height();
  uint16_t frameToX = 2;
  uint16_t frameToY = HEADER_HEIGHT + 4;
  uint16_t frameToWidth = SCREEN_WIDTH - 2 * frameToX;
  uint16_t frameToHeight = SCREEN_HEIGHT - HEADER_HEIGHT - 4 - 2;
  uint16_t innerToX = frameToX + 2;
  uint16_t innerToY = frameToY + 2;
  uint16_t innerToWidth = frameToWidth - 4;
  uint16_t innerToHeight = frameToHeight - 4;

  if(noteScreenIndex < 0 || noteScreenIndex > 5){
    // If outside current space
    elementsFromHeight = 0;
    elementsFromY = SCREEN_HEIGHT;
  }

  unsigned long startTime = millis();
  unsigned long endTime = startTime + SCREEN_SWITCH_TIME;
  while (millis() <= endTime) {
    unsigned long deltaTime = millis() - startTime;
    float animProgress = ((float)deltaTime) / ((float)SCREEN_SWITCH_TIME);
    float animProgressEased = easeInOut(animProgress);
    if (animProgressEased>1){
      animProgressEased = 1;
    }
    animProgressEased = 1.0 - animProgressEased;

    memmove(
          display.getBuffer(),  // Destination
          offScreen.getBuffer(),       //Source
          (SCREEN_HEIGHT * SCREEN_WIDTH) / 8 );//Length

    uint16_t frameX = animProgressEased * ((float)(frameToX - elementsFromX)) + elementsFromX;
    uint16_t frameY = animProgressEased * ((float)(frameToY - elementsFromY)) + elementsFromY;
    uint16_t frameWidth = animProgressEased * ((float)(frameToWidth - elementsFromWidth)) + elementsFromWidth;
    uint16_t frameHeight = animProgressEased * ((float)(frameToHeight - elementsFromHeight)) + elementsFromHeight;

    display.fillRect(frameX, frameY, frameWidth, frameHeight, BLACK);

    uint16_t innerX = animProgressEased * ((float)(innerToX - elementsFromX)) + elementsFromX;
    uint16_t innerY = animProgressEased * ((float)(innerToY - elementsFromY)) + elementsFromY;
    uint16_t innerWidth = animProgressEased * ((float)(innerToWidth - elementsFromWidth)) + elementsFromWidth;
    uint16_t innerHeight = animProgressEased * ((float)(innerToHeight - elementsFromHeight)) + elementsFromHeight;
    display.fillRect(innerX, innerY, innerWidth, innerHeight, WHITE);

    display.drawBitmap(innerX, innerY, noteField.getBuffer(), noteField.width(), noteField.height(), BLACK, WHITE);

    display.refresh();
  }
  fullscreenNoteNumber = -1;
  redrawDisplay(true);
}

void DisplayManager::drawFullscreenNote(){
  uint16_t frameToX = 2;
  uint16_t frameToY = HEADER_HEIGHT + 4;
  uint16_t frameToWidth = SCREEN_WIDTH - 2 * frameToX;
  uint16_t frameToHeight = SCREEN_HEIGHT - HEADER_HEIGHT - 4 - 2;
  uint16_t innerToX = frameToX + 2;
  uint16_t innerToY = frameToY + 2;
  uint16_t innerToWidth = frameToWidth - 4;
  uint16_t innerToHeight = frameToHeight - 4;
  // TODO Cleanup / Extract repeated constants
  display.fillRect(frameToX, frameToY, frameToWidth, frameToHeight, BLACK);
  display.fillRect(innerToX, innerToY, innerToWidth, innerToHeight, WHITE);
  String noteText = nm->getNoteText(fullscreenNoteNumber);
  uint8_t textSize = systemConfig.minTextSize;
  if (!systemConfig.constTextSize){
    textSize = getFullscreenTextSizeFromLength(noteText.length());
  }
  display.setTextSize(textSize);
  display.setCursor(innerToX + 2, innerToY + 2);
  for (uint16_t i = 0; i<noteText.length(); i++){
    if (display.getCursorX() + textSize * BASE_CHARACTER_WIDTH  > innerToX + innerToWidth - 2){
      // If going outside text box bounds, newline
      display.setCursor(innerToX + 2, display.getCursorY() + textSize * BASE_CHARACTER_HEIGHT);
    }
    display.print(noteText.charAt(i));
  }
}


bool DisplayManager::isFullscreenNote() {
        return fullscreenNoteNumber >= 0;
    }
